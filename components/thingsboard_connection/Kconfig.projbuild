## components/thingsboard_connection/Kconfig.projbuild
```kconfig
menu "SBC"
    config EXAMPLE_HTTP_ENDPOINT
        string "SBC"
        default "demo.thingsboard.io"
        help
            Target endpoint host-name for the example to use.
endmenu
```
